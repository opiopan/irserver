## main/Kconfig.projbuild
```kconfig
menu "irserver Configuration"

config WIFI_SSID
    string "WiFi SSID"
	default "myssid"
	help
		SSID (network name) for the example to connect to.

config WIFI_PASSWORD
    string "WiFi Password"
	default "myssid"
	help
		WiFi password (WPA or WPA2) for the example to use.

		Can be left blank if the network has no security set.

config OTA_IMAGE_SIGNING_KEY
     string "Private signing key for OTA firmware image"
	default "$(HOME)/esp/deploy/signingkey.pem"
	help
		Path to the key file used to sign firmware image for OTA.
		Key file is SRA private key in PEM format.

		This signing & verification mechanizm just gurantee only official firmware will be accepted via OTA. It means this is not perfect security solution, such as providing protection via serial update.
		To realize perfect security solution, please use Secure Boot of ESP-IDF.

config OTA_IMAGE__VERIFICATION_KEY
    string "Public signature verification key for OTA firmware image"
	default "$(HOME)/esp/deploy/verificationkey.pem"
	help
		Path to a public key file used to verify signed images recieved via OTA. This key is packed into the PDATA partition image,
		Key file is SRA public key in PEM format.

endmenu
```

## sdkconfig.defaults
```kconfig
#
# Serial flasher config
#
CONFIG_ESPTOOLPY_PORT="/dev/cu.SLAB_USBtoUART"

#
# Compiler options
#
CONFIG_CXX_EXCEPTIONS=y

#
# C++ settings
#
CONFIG_LIBCURL_PRESENT=y
```
